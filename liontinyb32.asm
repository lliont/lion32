;*       Tiny Basic port for Lion32 cpu/System
;*
;*         ported by Theodoulos Liontakis 2020
;*
;*          from  michael sullivan's 8086 port of
;*                               
;*                   Li-Chen Wang's
;*
;*                   8080 tiny basic 
;*
;* (c)copyleft
;* all wrongs reserved
;*
;*  New commands and fixed point arithmetic added

ISTACK	EQU	$4000
SDCBUF1	EQU	$4200  ;DS	514  Buffer 1 
SDCBUF2	EQU	$4402  ;DS	514  Buffer 2
SDCBUF3	EQU   $4604
FATBOOT	EQU	$4806  ; Fat boot #sector 
CURDIR	EQU	$4808  ; Root directory #sector 
FSTCLST	EQU	$480A  ; First data #sector
FSTFAT	EQU	$480C  ; First Fat first #sector
SDFLAG	EQU	$480E  ; SD card initialized by rom=256
COUNTER     EQU	$4810  ; General use counter increased by int 3 
CURSOR	EQU  	$4814  ; CURSOR XY
RHINT0	EQU	$4816  ; Hardware interrupt 0
RHINT1	EQU	$481C  ; Hardware interrupt 1
RHINT2	EQU	$4822
RINT6		EQU	$4828
RINT7		EQU	$482E
RINT8		EQU	$4834
RINT9		EQU	$483A
RINT15	EQU	$4840
XCN         EQU   79
YCN         EQU   29
VMODE		EQU   $4846
SCOL		EQU   $4847
SHIFT       EQU	$4848
CAPSL       EQU	$4849
CIRCX		EQU	$484A
CIRCY		EQU	$484C
PLOTM		EQU	$484E
SECNUM      EQU   $4850
SECPFAT     EQU   $4852
FATROOT     EQU   $4854
SDHC        EQU   $4856   ; is the sd hc ?
SDERROR     EQU   $4857   ; sd card #error
MAXMEM	EQU	$4858
RESRVB      EQU	$485C

ORG    $4864 	;Ram start

; RAM program ENTRY POINT
; A7 Reserved for decimal (was num2), in A6 fraction result of TSTNUM

START:	MOV.D	A1,STACK 
		SETSP	A1
		JSR	CLRMEM
		IN	A1,24  ; get mode
		CMP   A1,1
		JZ	VM1
		MOV	(DEFY),29
		MOV	(DEFX),79
		MOV.B   (PLOTM),1
		SETX  1589     ; set colors 
		MOV	A1,61152 
COLINIT:	OUT	A1,$F1F1
		JXAW	A1,COLINIT
		JR	16
VM1:		MOV	(DEFY),24
		MOV   (DEFX),52
		SETX	15   ; disable sprites mode 1
		MOV	A3,16391
		MOV	A4,16391+256
SPRLP1:	OUT.B A3,0
		OUT.B	A4,0
		ADD	A3,4096
		ADD	A4,4096
		OUT.B A3,0
		OUT.B	A4,0
		ADD	A3,4096
		ADD	A4,4096
		OUT.B A3,0
		OUT.B	A4,0
		SUB	A3,8184
		SUB   A4,8184
		JMPX	SPRLP1
		MOV	A1,$1F
		MOV.B	(SCOL),A1
		MOV	A3,(DEFY)
		MOV	(XX),A3     ;$001D ; Set INITIAL POS 
		MOV.D	A3,TITLE
		MOVI	A2,0
		MOVI	A0,0
		JSR	PRTSTG
		MOV.D	A3,TXTBGN
		MOV.D	A4,A3
		MOV.D	(TXTUNF),A3

RSTART:	MOVI  A7,0
 		MOVI  A6,0
		MOV.D	A0,STACK
		SETSP	A0
		IN	A1,24
		MOV	(DEFY),29
		MOV	(DEFX),79
		CMP   A1,1
		JNZ   ST2
		MOV	(DEFX),52
		MOV	(DEFY),24
ST2:		MOVI	A1,0
		MOV.D	(LOPVAR),A1
		MOV.D	(STKGOS),A1
		MOV.D	(CURRNT),A1
		;JSR	CRLF
		MOV	A5,(DEFY)
		MOV	(XX),A5
		MOV.D A3,OK 
		MOVI	A0,0
		JSR	prtstg
ST3:		MOV   (UINT),0
		MOVHL	A0,0
		MOV.B	A0,'>'
		JSR	GETLN
		PUSH	A4         ; A4 end of text in buffer
		MOV.D A3,BUFFER
		JSR	TSTNUM
		MOVHL	A0,0
		JSR	IGNBLNK
		CMP	A1,0      ; A1 num 
		POP	A2
		JZ	DIRECT
		SUBI	A3,2
		MOV	A0,A1
		MOV.D	A4,A3
		JSR	STOSW  ; store lineno to 
		PUSH	A2
		PUSH  A3
		MOV.D	A0,A2
		SUB.D	A0,A3
		PUSH	A0
		JSR	FNDLN
		PUSH	A3
		JNZ	ST4
		PUSH	A3
		JSR	FNDNXT

		POP	A2
		MOV.D	A1,(TXTUNF)
		JSR	MVUP
		MOV.D	A1,A2
		MOV.D	(TXTUNF),A1
ST4:		
		POP	A2
		MOV.D	A1,(TXTUNF)

		POP	A0
		PUSH	A1
		CMP   A0,3
		JZ	RSTART
		ADD.D	A0,A1
		MOV.D	A1,A0	
		MOV.D	A3,TXTEND
		CMP.D	A1,A3
		JNC	QSORRY
		MOV.D	(TXTUNF),A1
		POP	A3
		JSR	MVDOWN
		POP	A3
		POP	A1
		JSR	MVUP
		JMP	ST3

TSTV:		
		MOVHL	A0,'@'
		JSR	IGNBLNK
		JC	RET2
		JNZ	TV1
		JSR	PARN
		SLL.D	A1,3
		PUSH	A3
		XCHG	A1,A3
		JSR	SIZE
		CMP.D	A1,A3
		JC	ASORRY
		MOV.D A1,TXTEND
		SUB.D	A1,A3
		POP	A3
		RET

TV1:		CMP.B	A0,122 ;'z'  ; TEST VARIABLE
		JA	RET22
		CMP.B	A0,97
            JAE   TV2
		CMP.B A0,'Z'
		JA    RET22
		CMP.B A0,'A'
		JC	RET2
TV2:		ADDI	A3,1
		MOV.D	A1,VARBGN
		SUB.B	A0,65
		AND.D	A0,$000000FF
		SLL.D	A0,3
		ADD.D	A1,A0
RET2:		
		RET	
RET22:	
		SRSET	0
		RET

;----- TSTNUM

TSTNUM:
		MOVI	A1,0
		MOVI	A6,0
		MOVHL	A2,A1
		MOVHL	A0,0
		JSR	IGNBLNK
TN1:
		CMP.B	A0,'.'
		JZ	DECIM
		CMP.B	A0,'0'
		JC	RET2
		CMP.B A0,':'
		JNC	RET2
		ADD	A2,$0100
		PUSH	A2
		MOVI	A2,10
		MULU.D A1,A2
		MOVI	A0,0
            MOV.B	A0,(A3)
		SUB.B	A0,'0'
		MOVHL	A0,0
		ADDI	A3,1
		ADD.D	A1,A0
		POP	A2
		MOV.B A0,(A3)
		JP	TN1

NFR:		PUSH	A3
		MOV.D	A3,NFND
		JMP	ERROR
QHOW:
		PUSH	A3
AHOW:	
		MOV.D	A3,HOW
		JMP	ERROR

DECIM:	PUSH	A1
		PUSH	A2
		PUSH	A4
		MOVI	A4,1
		MOVI	A1,0
		;MOVI	A0,0
TN2:		ADDI	A3,1
		MOVI  A0,0
		MOV.B	A0,(A3)
		CMP.B	A0,'0'
		JC	DRET
		CMP.B A0,':'
		JNC	DRET
		MOVI	A2,10
		MULU.D A1,A2
		SUB.B	A0,'0'
		CMP.D	A4,1000000
		JZ	QHOW
		MOVI	A2,10
		MULU.D A4,A2
		ADD.D	A1,A0
		JNC	TN2	
		JMP	QHOW
DRET:		MOVI	A2,0
		MOV.D	A0,31 
		;SLL.D	A4,1
DTOB2:	OR	A0,A0
		JN	DTOBEND
		SLL.D	A1,1		
		CMP.D	A1,A4
		JC	DTOB1
		BSET	A2,A0
		SUBI	A0,1
		SUB.D	A1,A4
		JNZ	DTOB2
		JMP	DTOBEND
DTOB1:	SUBI	A0,1
		JMP	DTOB2	
DTOBEND:	MOV.D	A6,A2
		POP	A4
		POP	A2
		POP	A1
		RET

TSTUNUM:
		MOVI	A1,0
		MOVI	A6,0
		MOVHL	A2,A1
		MOVHL	A0,0
		JSR	IGNBLNK
UTN1:
		CMP.B	A0,'0'
		JC	RET2
		CMP.B A0,':'  ; is digit ?
		JNC	RET2
		ADD	A2,$0100
		PUSH	A2
		MOVI	A2,10
		MULU.D A1,A2
		CMPI	A2,0
		JNZ	QHOW
		MOVI	A0,0
            MOV.B	A0,(A3)
		SUB.B	A0,'0'
		MOVHL	A0,0
		ADDI	A3,1
		POP	A2
		ADD.D	A1,A0
		MOV.B A0,(A3)
		JNC	UTN1
		JMP   QHOW

;--------  tables ----
tab1:	
	TEXT	"LIS"
	DB	'T'+128
	DA	LIST
	TEXT	"NE"
	DB	'W'+128
	DA	NEW
	TEXT	"RU"
	DB	'N'+128
	DA	RUN
	TEXT	"BY"
	DB	'E'+128
	DA	NEW
	TEXT	"SLIS"
	DB	'T'+128
	DA	SLIST
	TEXT  "LOA"
	DB	'D'+128
	DA	LOAD
	TEXT  "SAV"
	DB	'E'+128
	DA	SAVE
	TEXT "FIN"
	DB	'D'+128
	DA	FIND
	TEXT	"DI"
	DB	'R'+128
	DA	DIR
	TEXT	"C"
	DB	'D'+128
	DA	CD


TAB2	TEXT	"PRIN"
	DB	'T'+128
	DA	PRINT
	TEXT	"I"
	DB	'F'+128
	DA	IFF
	TEXT	"NEX"
	DB	'T'+128
	DA	NEXT
	TEXT	"GOT"
	DB	'O'+128
	DA	GOTO
	TEXT	"GOSU"
	DB	'B'+128
	DA	GOSUB
	TEXT	"RETUR"
	DB	'N'+128
	DA	RETURN
	TEXT	"FO"
	DB	'R'+128
	DA	FOR
      TEXT	"PLO"
	DB	'T'+128
	DA	TPLOT
	TEXT	"PO"
	DB	'S'+128
      DA	ATCMD
	TEXT	"OUT"
	DB	'B'+128
	DA	OUTBCMD
	TEXT	"OU"
	DB	'T'+128
	DA	OUTCMD
	TEXT	"RE"
	DB	'M'+128
	DA	REM
	TEXT	"INPU"
	DB	'T'+128
	DA	INPUT
	DB	'?'+128
	DA	PRINT
	TEXT	"POK"
	DB	'E'+128
	DA	POKE
	TEXT	"COLO"
	DB	'R'+128
	DA	COLOR
	TEXT	"BEE"
	DB	'P'+128
	DA	BEEP
	TEXT  "LIN"
	DB    'E'+128
	DA	LINE
	TEXT  "CIRCL"
	DB    'E'+128
	DA	CIRCLE
	TEXT	"FCOLO"
	DB	'R'+128
	DA	FORE
	TEXT	"BCOLO"
	DB	'R'+128
	DA	BACK
	TEXT	"CLS"
	DB	'P'+128
	DA	CLSSP
	TEXT	"CL"
	DB	'S'+128
	DA	CLS
	TEXT	"LE"
	DB	'T'+128
	DA	LET
	TEXT	"SCREE"
	DB	'N'+128
	DA	SCREEN
	TEXT  "LCOD"
	DB	'E'+128
	DA	LCODE
	TEXT  "SCOD"
	DB	'E'+128
	DA	SCODE
	TEXT  "RCOD"
	DB	'E'+128
	DA	RCODE
	TEXT  "LSCR"
	DB	'N'+128
	DA	LSCRN
	TEXT  "GCOD"
	DB	'E'+128
	DA	GCODE
	TEXT  "DELET"
	DB	'E'+128
	DA	DELETE
	TEXT  "MOD"
	DB	'E'+128
	DA	MODE
	TEXT	"PMOD"
	DB	'E'+128
	DA	PLOTMD
	TEXT	"STO"
	DB	'P'+128
	DA	STOP
	DB 	128
	DA	DEFLT

TAB4	TEXT	"KE"
	DB	'Y'+128
	DA	KEY
	TEXT	"RN"
	DB	'D'+128
	DA	RND
	TEXT	"ROUN"
	DB	'D'+128
	DA	ROUND
	TEXT	"AB"
	DB	'S'+128
	DA	MYABS
	TEXT	"IN"
	DB	'P'+128
	DA	INP
	TEXT	"PEE"
	DB	'K'+128
	DA	PEEK
	TEXT	"IN"
	DB	'T'+128
	DA	TOINT
	TEXT	"JOY"
	DB	'1'+128
	DA	JOYST1
	TEXT	"JOY"
	DB	'2'+128
	DA	JOYST2
	TEXT	"SI"
	DB	'N'+128
	DA	SIN
	TEXT	"CO"
	DB	'S'+128
	DA	COS
	TEXT	"P"
	DB	'I'+128
	DA	PI
	TEXT	"SQR"
	DB	'T'+128
	DA	SQRT
;	TEXT	"EX"
;	DB	'P'+128
;	DA	EXPO
;	TEXT	"L"
;	DB	'N'+128
;	DA	LN
	TEXT  "TIME"
	DB	'R'+128
	DA	TIMER
	TEXT	"SIZ"
	DB	'E'+128
	DA	SIZE
	TEXT	"WAIT"
	DB	'K'+128
	DA	WAITK
	TEXT	"US"
	DB	'R'+128
	DA	USR
	TEXT	"SDINI"
	DB	'T'+128
	DA	SDINIT
	TEXT  "BTO"
	DB	'P'+128
	DA	BTOP
	DB	128
	DA	XP40

TAB5	DB	'T', 'O'+128
	DA	FR1
	DB	128
	DA	QWHAT

TAB6	TEXT	"STE"
	DB	'P'+128
	DA	FR2
	DB	128
	DA	FR3
TAB8	DB	'>'
	DB 	'='+128
	DA	XP11
	DB	'#'+128
	DA	XP12
	DB	'>'+128
	DA	XP13
	DB	'='+128
	DA	XP15
	DB	'<'
	DB	'='+128
	DA	XP14
	DB	'<'+128
	DA	XP16
	DB	128	
	DA	XP17


DIRECT:
	MOV.D	A1,TAB1
	SUBI	A1,1
EXEC:	
	MOVHL	A0,0
	JSR	IGNBLNK
	PUSH	A3
EX1:
	MOV.B	A0,(A3)
      CMP.B A0,97
      JB	SKIPUP
      CMP.B A0,128
	JAE   SKIPUP
      AND.B	A0,$DF        ; UPPER CASE 
SKIPUP: ADDI A3,1
	CMP.B	A0,'.'   
	JZ	EX4
	ADDI	A1,1
	MOV.B	A4,(A1)
	BCLR	A4,7
	XOR.B A4,A0
	JZ	EX2
EX0A:                   ; not equal 
	CMP.B	(A1),128
	JNC	EX0B
	ADDI	A1,1
	JMP	EX0A
EX0B:
	ADD.D	A1,5     ; next keyword
	BTST	A1,0
	JZ	ALI2
	ADDI	A1,1
ALI2: POP	A3
	CMP.B (A1),128
	JZ	EX3A
	SUBI	A1,1
	JMP	EXEC
EX4:
	ADDI	A1,1    ; found ending with .
	CMP.B	(A1),128
	JC	EX4
	JMP	EX3
EX2:
	CMP.B	(A1),128
	JC	EX1
EX3:
	POP	A0
EX3A:	ADDI	A1,1
	BTST	A1,0   ; ALIGN TO EVEN ADDRESS
	JZ	ALIG
	ADDI	A1,1
ALIG:	JMP 	(A1)
;--------------------

NEW:
	JMP	START

STOP:
	JSR	ENDCHK
	JMP	RSTART

RUN:
	JSR	ENDCHK
	MOV.D	A3,TXTBGN

RUNNXL:
	MOVI	A1,0
	JSR	FNDLNP
	JNC	RUNTSL
	JMP	RSTART

RUNTSL:
	MOV.D	(CURRNT),A3
	ADDI	A3,2
RUNSML:
	JSR	CHKIO
	MOV.D	A1,TAB2
	SUBI	A1,1
	JMP	EXEC

GOTO:
	JSR	EXP
	PUSH	A3
	JSR	ENDCHK
	JSR	FNDLN
	JNZ	AHOW
	POP	A0
	JMP	RUNTSL

; ----------- LIST 
SLIST:
	MOV.B	(SER),1  ; REDIRECT TO SERIAL PORT

LIST:	MOVI	A5,0
	JSR	TSTNUM
	JSR	ENDCHK
	JSR	FNDLN
LS1:
	JNC	LS2
	MOV.B	(SER),0
	JMP	RSTART
LS2:
	JSR	PRTLN
	JSR	CHKIO
	INC	A5
	CMP	A5,23
	JB	LS3
	MOVI	A5,0
	JSR	WAITK
LS3:	JSR	FNDLNP
	JMP	LS1

FIND:
	JSR	TSTNUM
	JSR	ENDCHK
	JSR	FNDLN
	JC	RSTART
	JSR	PRTLN
	JMP	ST3

PRINT:
	MOVI.B A2,3
	MOVHL	A0,59
	JSR	IGNBLNK
	JNZ	PR2
	JSR	CRLF
	JMP	RUNSML
PR2:
	MOVHL	A0,13
	JSR	IGNBLNK
	JNZ	PR0
	JSR	CRLF
	JMP	RUNNXL
PR0:	
	MOVHL	A0,'#'
	JSR	IGNBLNK
	JNZ	PR1
	JSR	EXP
	MOV.B	A2,A1
	JMP	PR3
PR1:
	JSR	QTSTG
	JMP	PR8
PR3:
	MOVHL	A0,44
	JSR	IGNBLNK
	JNZ	PR6
	JSR	FIN
	JMP	PR0
PR6:
	MOVHL	A0,'\'
	JSR	IGNBLNK
	JZ	FINISH
	JSR	CRLF
	JMP	FINISH
PR8:
	JSR	EXP
	PUSH	A2
	JSR	PRTNUM
	MOV.D	A1,A7
	CMPI	A1,0
	JZ	PR9
	MOV.B	A0,'.'
	JSR	CHROUT
	JSR	FRACTION
PR9:	POP	A2
	JMP	PR3

FRACTION:
	PUSH	A3
	PUSH	A4
	MOVI	A4,0
	MOV.D	A3,5000000
	SETX	31
FRA1:	MOV	A0,31
	BTST	A1,A0
	JZ	FRA2
	ADD.D	A4,A3
FRA2:	SRL.D	A3,1
	SLL.D	A1,1
	JMPX	FRA1
	MOV.D	A1,A4
	MOVI	A2,6
	JSR	PRTUNUM
	POP	A4
	POP	A3
	RET

;--------------  GOSUB

GOSUB:
	JSR	PUSHA
	JSR	EXP
	PUSH	A3
	JSR	FNDLN
	JNZ	AHOW
	MOV.D	A1,(CURRNT)
	PUSH	A1
	MOV.D	A1,(STKGOS)
	PUSH	A1
	MOVI	A1,0
	MOV.D	(LOPVAR),A1
	GETSP	A0
	MOV.D	(STKGOS),A0
	JMP	RUNTSL

RETURN:
	JSR	ENDCHK
	MOV.D	A1,(STKGOS)
	CMP.D	A1,0
	JZ	QWHAT
	SETSP	A1
	POP	A1
	MOV.D	(STKGOS),A1
	POP	A1
	MOV.D	(CURRNT),A1
	POP	A3
	JSR	POPA
	JMP 	FINISH

; ----------for

FOR:	JSR	PUSHA
	JSR	SETVAL
	SUBI	A1,4
	MOV.D	(LOPVAR),A1
	MOV.D	A1,TAB5
	SUBI	A1,1
	JMP	EXEC
FR1:
	JSR	EXP
	MOV.D	(LOPLMT),A1
	MOV.D	A1,TAB6
	SUBI	A1,1
	JMP	EXEC
FR2:
	JSR	EXP
	JMP	FR4
FR3:
	MOVI	A1,1
FR4:
	MOV.D	(LOPINC),A1
FR5:
	MOV.D	A1,(CURRNT)
	MOV.D	(LOPLN),A1
	XCHG	A1,A3
	MOV.D	(LOPPT),A1
	MOV.D	A2,20 ; was 10 
	MOV.D	A1,(LOPVAR)
	XCHG	A3,A1
	MOV.D	A1,A2
	GETSP	A0
	ADD.D	A1,A0
	JMP	FR7A
FR7:
	ADD.D	A1,A2
FR7A:
	MOV.D	A0,(A1)
	CMPI	A0,0
	JZ	FR8
	CMP.D	A0,A3
	JNZ	FR7
	XCHG	A3,A1
	GETSP	A1
	MOV.D	A2,A1
	MOV.D	A1,20  ; was 10
	ADD.D	A1,A3
	JSR	MVDOWN
	SETSP	A1
FR8:
	MOV.D	A1,(LOPPT)
	XCHG	A1,A3
	JMP 	FINISH
NEXT:
	JSR	TSTV
	JC	QWHAT
	MOV.D	(VARNXT),A1   ; text pointer
NX0:
	PUSH	A3
	XCHG	A3,A1
	MOV.D	A1,(LOPVAR)
	CMPI	A1,0
	JZ	AWHAT
	CMP.D	A3,A1
	JZ	NX3
	POP	A3
	JSR	POPA
	MOV.D	A1,(VARNXT)
	JMP	NX0
NX3:
	MOV.D	A3,(A1)
	MOV.D	A1,(LOPINC)
	PUSH	A1
	ADD.D	A1,A3
	XCHG	A3,A1
	MOV.D	A1,(LOPVAR)
	MOV.D (A1),A3
	MOV.D	A1,(LOPLMT)
	POP	A0
	CMPI 	A0,0
	JP	NX1
	XCHG	A1,A3
NX1:
	JSR	CKHLDE2
	POP	A3
	JC	NX2
	MOV.D	A1,(LOPLN)
	MOV.D	(CURRNT),A1
	MOV.D	A1,(LOPPT)
	XCHG	A3,A1
	JMP 	FINISH
NX2:
	JSR	POPA
	JMP 	FINISH	

; ------------ EXPRES

SIZE:
	MOV.D	A1,TXTEND  ;VARBGN
	SUB.D	A1,(TXTUNF) ;A3
RET10:
	RET

; ------------ DIVIDE

DIVIDE:  ; INT 4/9 Div A2 by A1 res in A1,A0
	MOV.D	A2,A1
	MOV.D	A1,A3
	CMP	(UINT),0
	JNZ	DV1
	MOVI	A0,9
	INT	4
	JMP	DVE
DV1:	MOVI	A0,6
	INT	5
DVE:	MOV.D	A2,A1
	XCHG	A0,A1
	RET

UDIVIDE:  ; INT 4/9 Div A2 by A1 res in A1,A0
	MOV.D	A2,A1
	MOV.D	A1,A3
	MOVI	A0,6
	INT	5
	MOV.D	A2,A1
	XCHG	A0,A1
	RET

	
DIVIDE2:  ; INT 5/1 Div A2 by A1 res in A1,A0
	MOV.D	A2,A1
	MOV.D	A1,A3
	JSR   FDIV
	MOV.D	A2,A1
	XCHG	A0,A1
	RET

CHKSGN:
	CMPI	A1,0
	JP	RET11
CHGSGN:
	NOT.D	A1
      NEG.D A7
	ADC.D	A1,0
	XOR.D	A2,$80000000
RET11:
	RET

CKHLDE:
	MOV.D	A0,A1
	XOR.D	A0,A3
	JP	CK1
	XCHG	A3,A1
CK1:	CMP.D	A1,A3
	JNZ   CK2
	MOV.D	A0,A7
	CMPI	A1,0
	JN	CK3
	NEG.D	A4
CK3:	CMPI	A3,0
	JZ	CK4
	NEG.D	A0
CK4:	CMP.D	A4,A0 ;(NUM2)
CK2:	RET


CKHLDE2:
	MOV.D	A0,A1
	XOR.D	A0,A3
	JP	CK11
	XCHG	A3,A1
CK11:	CMP.D	A1,A3
	RET

;---- GETVAL FIN

SETVAL:
	JSR	TSTV
	JC	QWHAT
	PUSH	A1
	MOVHL	A0,'='
	JSR	IGNBLNK
	JNZ	QWHAT
	JSR	EXP
	MOV.D	A2,A1
	POP	A1
	MOV.D	(A1),A2
	ADDI	A1,4
	MOV.D	(A1),A7
	RET

FINISH:
	JSR	FIN
	JMP	QWHAT

FIN:
	MOVHL	A0,59
	JSR	IGNBLNK
	JNZ	FI1
	POP	A0
	JMP	RUNSML
FI1:
	MOVHL	A0,13
	JSR	IGNBLNK
	JNZ	FI2
	POP	A0
	JMP	RUNNXL
FI2:
	RET

ENDCHK:
	MOVHL	A0,13
	JSR	IGNBLNK
	JZ	FI2
QWHAT:
	PUSH	A3
AWHAT:
	MOV.D	A3,WHAT
ERROR:
	MOVI	A0,0
	JSR	PRTSTG
	POP	A3
	MOV.D	A1,(CURRNT)
	CMP.D	A1,0
	JZ	RSTART
	JN	INPERR
	MOV.D	A4,A1
	JSR	LODSW
	JSR	FNDLN
	MOV.D	A3,A1
	JSR	PRTLN
	POP	A2
ERR2:
	JMP	RSTART
QSORRY:
	PUSH	A3
ASORRY:
	MOV.D	A3,SORRY
	JMP	ERROR
;-----

REM:
	MOVI	A1,0
	JMP	IFF1A

IFF:
	JSR	EXP
IFF1A:
	CMPI	A1,0
	JNZ	RUNSML
	JSR	FNDSKP
	JNC	RUNTSL
	JMP	RSTART

INPERR:
	MOV.D	A1,(STKINP)
	SETSP	A1
	POP	A1
	MOV.D	(CURRNT),A1
	POP	A3
	POP	A3

INPUT:
	PUSH	A3
	JSR	QTSTG
	JMP	IP2
	JSR	TSTV
	JC	IP4
	JMP	IP3
IP2:
	PUSH	A3
	JSR	TSTV
	JC	QWHAT
	MOV.B A2,(A3)
	MOVI  A0,0  
	MOV.B	(A3),A0
	POP	A3
	JSR	PRTSTG
	MOV.B	A0,A2
	SUBI	A3,1
	MOV.B	(A3),A0
IP3:
	PUSH	A3
	XCHG	A1,A3
	MOV.D	A1,(CURRNT)
	PUSH	A1
	MOV.D	A0,-1
	MOV.D	(CURRNT),A0
	GETSP	A0
	MOV.D	(STKINP),A0
	PUSH	A3
	MOV.D	A0,58 ;':'
	JSR	GETLN

	MOV.D	A3,BUFFER
	JSR	EXP
	POP	A3
	XCHG	A1,A3

	MOV.D (A1),A3
	ADDI	A1,4
	MOV.D	(A1),A7

	POP	A1
	MOV.D	(CURRNT),A1
	POP	A3
IP4:
	POP	A0
	MOVHL	A0,44
	JSR	IGNBLNK
	JNZ	FINISH
	JMP	INPUT
	

DEFLT:
	MOV.B	A0,(A3)
	CMPI.B A0,13
	JZ	FINISH
LET:
	JSR	SETVAL
	MOVHL	A0,44
	JSR	IGNBLNK
	JNZ	FINISH
	JMP	LET

;-----
EXP:	MOVI	A7,0
	JSR	EXPR2
	PUSH	A1
	PUSH	A7
	
EXPR1:
	MOV.D	A1,TAB8
	SUBI	A1,1
	JMP 	EXEC
XP11:
	JSR	XP18
	JC	RET4
	MOV.B	A1,A0
	RET
XP12:
	JSR	XP18
	JZ	RET4
	MOV.B	A1,A0
RET4:
	RET
XP13:
	JSR	XP18
	JBE	RET5
	MOV.B	A1,A0
RET5:
	RET
XP14:
	JSR	XP18
	MOV.B	A1,A0
	JBE	RET6
	MOVLH	A1,A1
RET6:
	RET
XP15:
	JSR	XP18
	JNZ	RET7
	MOV.B A1,A0
RET7:
	RET
XP16:
	JSR	XP18
	JNC	RET8
	MOV.B	A1,A0
RET8:
	RET
XP17:
	POP	A4
	POP	A1
	MOV.D	A7,A4 ;*************
	RET
XP18:
	MOV.B	A0,A2
	POP	A1
	POP	A4
	POP	A2
	PUSH	A1
	PUSH	A2
	PUSH	A4
	MOV.B	A2,A0
	JSR	EXPR2
	XCHG	A1,A3
	POP	A4
	POP	A0
	PUSH	A1
	MOV.D	A1,A0
	JSR	CKHLDE
	MOVI	A7,0
	POP	A3
	MOVI	A1,0
	MOVI.B A0,1
	RET

EXPR2:
	MOVHL	A0,'-'
	JSR	IGNBLNK
	JNZ	XP21
	MOVI	A1,0
	JMP	XP26
XP21:
	MOVHL	A0,'+'
	JSR	IGNBLNK
XP22:
	JSR	EXPR3
XP23:
	MOVHL	A0,'+'
	JSR	IGNBLNK
	JNZ	XP25
	PUSH	A1
	PUSH	A7
	JSR	EXPR3
XP24:
	XCHG	A1,A3
	POPX
	POP	A0
	PUSH	A1
	MOV.D	A1,A0
	MOV.D	A0,A7
	MOVX A4	
	ADD.D	A4,A0
	ADC.D	A1,A3
	MOV.D	A7,A4
	POP	A3
	JO	QHOW
	JMP	XP23
XP25:
	MOVHL	A0,'-'
	JSR	IGNBLNK
	JNZ	RET9
XP26:
	PUSH	A1
	PUSH	A7
	JSR	EXPR3
	JSR	CHGSGN
	JMP	XP24

EXPR3:
	JSR	EXPR4
XP31:
	MOVHL	A0,'*'
	JSR	IGNBLNK
	JNZ	XP34
	PUSH	A1
	PUSH	A7
	JSR	EXPR4
	XCHG	A1,A3
	POP	A4
	POP	A0
	PUSH	A1
	PUSH	A0
	PUSH	A2
	MOV.D	(FRAC2),A4
	MOV.D	(FRAC1),A7
	MOV.D	A1,A3
	MOV.D	A2,A0
	JSR	FMULT
	MOV.D	A7,(FRAC1)
	;CMP   A0,0   ; check overflow
	POP	A2
	POP	A0
	JMP	XP35
XP34:
	MOVHL	A0,'/'
	JSR	IGNBLNK
	JNZ	XP44
      PUSH	A1
	PUSH	A7
	JSR	EXPR4
	XCHG	A1,A3
	POP	A4
	POP	A0
	PUSH	A1          ; a3
	MOV.D	(FRAC2),A4
	MOV.D	A4,A7
	MOV.D	(FRAC1),A4
	MOV.D	A1,A0           ; dividend
	MOV.D	A0,A3		   ; divider
	OR.D	A0,A4 ;(FRAC1)
	JZ	AHOW
	PUSH	A2
	JSR	DIVIDE2
	MOV.D	A7,(FRAC1)
	MOV.D	A1,A2
	POP	A2
XP35:
	POP	A3
	JMP	XP31


XP44:
	MOVHL	A0,'%'
	JSR	IGNBLNK
	JNZ	XP55
	PUSH	A1
	JSR	EXPR4
	XCHG	A1,A3
	POP	A0
	PUSH	A1
	MOV.D	A1,A0
	CMPI   A3,0
	JZ	AHOW
	PUSH	A2
	JSR	DIVIDE
	MOVI	A7,0
	POP	A2
	JMP	XP35

XP55:
	MOVHL	A0,124     ;'|'
	JSR	IGNBLNK
	JNZ	RET9
	PUSH	A1
	JSR	EXPR4
	XCHG	A1,A3
	POP	A0
	PUSH	A1
	MOV.D	A1,A0
	CMPI	A3,0
	JZ	AHOW
	PUSH	A2
	JSR	DIVIDE
	MOVI	A7,0
	MOV.D	A1,A2
	POP	A2
	JMP	XP35

EXPR4:
	MOV.D	A1,TAB4
	SUBI	A1,1
	JMP	EXEC
XP40:   		
	JSR	TSTV  ; VARIABLE ?
	JC	XP41
	MOV.D	A0,(A1)
	ADDI	A1,4
	XCHG	A1,A0
	MOV.D	A7,(A0)
RET9:
	RET
XP41:	
	CMP	(UINT),0
	JNZ	UIN
	JSR	TSTNUM	; NUMBER ?
	JMP	NUIN
UIN:  JSR   TSTUNUM
NUIN:	MOVLH A0,A2
	OR.B	A0,A0
	JZ	PARN
	MOV.D	A7,A6
	RET
PARN:
	MOVHL	A0,'('
	JSR	IGNBLNK
	JNZ	PARN1
	JSR	EXP
PARN1:
	MOVHL	A0,')'
	JSR	IGNBLNK
	JNZ	XP43
XP42:
	RET
XP43:
	JMP	QWHAT

	
MYABS:
	JSR	PARN
	JSR	CHKSGN
	OR.D	A0,A1
	JP	RET10
	JMP	QHOW

;-----  my ROUTINES

LSCRN:
	PUSH	A5
	PUSH	A4
	MOVI	A5,0
	MOV.D	A4,FNAME3 
	MOV	A0,(SDFLAG)
	CMP	A0,256
	JNZ	QHOW
	MOVHL	A0,34
	JSR	IGNBLNK
	JNZ	QWHAT
	PUSHX
	PUSH	A1
	SETX	7
SLD1: MOV.B	A0,(A3)
	CMP.B	A0,31
	JBE	QWHAT
	MOV.B	(A4),32
	CMP.B	A0,34
	JZ	SLD2
	ADDI	A3,1
	MOV.B	(A4),A0
SLD2:	JXAB	A4,SLD1
	MOVHL	A0,34   
	JSR	IGNBLNK
	JNZ	QWHAT
	MOVHL	A0,44    
	JSR	IGNBLNK
	JNZ	QWHAT
	MOV.D	A4,A3
	MOV   (UINT),1
	JSR	EXP
	MOV   (UINT),0
	MOV.D	A4,FNAME3
	PUSH	A3
	PUSH	A5
	MOV.D	A3,A1          ; load address
	MOVI	A0,13
	INT	5              ; LOAD SCREEN
	POP	A5
	POP	A3
	CMPI	A0,0
	JZ	QHOW
SLD3:	POP	A1
	POPX
	POP	A4
	POP	A5
	JMP	FINISH
; ---------------------------
LCODE:
	PUSH	A5
	PUSH	A4
	MOVI	A5,1
	MOV.D	A4,FNAME2
	JMP	LCODI
LOAD:	
	PUSH	A5
	PUSH	A4
	MOVI	A5,0
	MOV.D	A4,FNAME
	
LCODI: 
	CMP	(SDFLAG),256
	JNZ	QHOW
	MOVHL	A0,34
	JSR	IGNBLNK
	JNZ	QWHAT
	PUSHX
	PUSH	A1
	SETX	7
LD1:  MOV.B	A0,(A3)
	CMP.B	A0,31
	JBE	QWHAT
	MOV.B	(A4),32
	CMP.B	A0,34
	JZ	LD2
	ADDI	A3,1
	CMP.B A0,97
      JB	SKPU1
      CMP.B A0,128
	JAE   SKPU1
	AND.B	A0,$DF ; *UPPER CASE*
SKPU1: MOV.B (A4),A0
LD2:	JXAB	A4,LD1
	ADDI	A4,1
	MOVHL	A0,34   
	JSR	IGNBLNK
	JNZ	QWHAT 
	CMPI  A5,0
	JZ	LD4  ; load or lcode
	MOVHL	A0,44     ;lcode
	JSR	IGNBLNK
	JNZ	QWHAT
	MOV.D	A4,A3
	MOV   (UINT),1
	JSR	EXP
	MOV   (UINT),0
	MOV.D	A4,FNAME2
	JMP	LD6
LD4:	MOV.D	A4,FNAME
	MOV.D	A1,TXTBGN
LD6:	PUSH	A3
	PUSH	A4
	MOV.D	A3,A1          ; load address
	MOVI	A0,2
	INT	5              ; LOAD FILE
	POP	A4
	POP	A3
	CMPI   A0,0
	JZ	NFR
	CMPI	A5,0
	JNZ	LD3
	ADD.D	A1,TXTBGN
LD7:	MOV.D	(TXTUNF),A1
LD3:	POP	A1
	POPX
	POP	A4
	POP	A5
	JMP	FINISH
	
;--------------------------

DELAY: PUSHX
	 SETX	65000
LDDL:  JMPX	LDDL    ;delay
	 POPX
	 RET

DIR:
	PUSHX
	PUSH	A2
	PUSH	A4
	PUSH	A5
	MOVI	A0,13
	JSR	CHROUT
	MOVI	A5,0
TBF4:	MOV	A1,(CURDIR)
	ADD	A1,A5
	MOVI	A0,13
	MOV.D	A2,SDCBUF1
	INT	4              ; Load Root Folder 1st sector
	CMP	A5,0
	JNZ	TBF3
	SETX	7
	PUSH	A2
	MOV.D	A2,THISDIR
TBF7:	MOV.B	A0,(A2)
	ADDI	A2,1
	JSR	CHROUT             ; print volume name
	JMPX	TBF7
	MOVI	A0,13
	JSR	CHROUT
	MOVI	A0,13
	JSR	CHROUT
	POP	A2
	MOV.B	(A2),$05
	ADD	A2,32
	MOV.B	(A2),$05
	SUB	A2,32
TBF3:	JSR	DELAY
	MOVI	A4,0
TBF1:	CMP.B	(A2),0     ; empty
	JZ	TBF5
	CMP.B	(A2),$E5   ; deleted entry
	JZ	TBF6
	CMP.B	(A2),46
	JBE	TBF6
	PUSH	A2
	SETX	7
TBF2: MOV.B	A0,(A2)
	ADDI	A2,1
	JSR	CHROUT
	JMPX	TBF2
	MOV	A0,46     ; print .
	JSR	CHROUT
	SETX	2
TBF22: MOV.B	A0,(A2)
	ADDI	A2,1
	JSR	CHROUT
	JMPX	TBF22
	ADD	A2,17
	MOV.D	A1,(A2)
	SWAP	A1	;FILE SIZE
	SWAP.D A1
	SWAP	A1
	MOV	A0,32
	JSR	CHROUT
	MOV	A0,32
	JSR	CHROUT
	MOV	A0,32
	JSR	CHROUT
	PUSH	A4
	MOV	A2,4
	MOV	A0,A1	
	MOV	(LZERO),0
	JSR	PRTUNUM
	MOV	(LZERO),1
	POP	A4
	MOVI	A0,13
	JSR	CHROUT
	POP	A2       
TBF6:	ADD	A2,32
	ADD	A4,32
	CMP	A4,512
	JNZ	TBF1  ; search same sector
	ADDI	A5,1
	CMP	A5,32  ;if not last root dir sector 
	JNZ	TBF4   ;load next sector and continue search
TBF5:	POP	A5
	POP	A4
	POP	A2
	POPX
	JMP	FINISH


;------------------------------

SCODE:
	PUSH	A5
	PUSH	A4
	MOVI	A5,1
	MOV.D	A4,FNAME2
	JMP	SCODI
SAVE:	
	PUSH	A5
	PUSH	A4
	MOVI	A5,0
	MOV.D	A4,FNAME
	
SCODI: 
	CMP	(SDFLAG),256
	JNZ	QHOW
	MOVHL	A0,34
	JSR	IGNBLNK
	JNZ	QWHAT
	PUSHX
	PUSH	A1
	PUSH	A6
	PUSH	A7
	SETX	7
SD1:  MOV.B	A0,(A3)
	CMP.B	A0,31
	JBE	QWHAT
	MOV.B	(A4),32
	CMP.B	A0,34
	JZ	SD2
	ADDI	A3,1
	CMP.B A0,97
      JB	SKUP2
      CMP.B A0,128
	JAE   SKUP2
	AND.B	A0,$DF ; *UPPER CASE*
SKUP2: MOV.B (A4),A0
SD2:	JXAB	A4,SD1
	MOVHL	A0,34   
	JSR	IGNBLNK
	JNZ	QWHAT
	CMPI	A5,0
	JZ	SD4  ; save or scode
	MOVHL	A0,44     ;scode
	JSR	IGNBLNK
	JNZ	QWHAT
	MOV.D	A4,A3
	MOV   (UINT),1
	JSR	EXP
	MOV   (UINT),0
	PUSH	A1
	MOVHL	A0,44     ;scode
	JSR	IGNBLNK
	JNZ	QWHAT
	MOV   (UINT),1
	JSR	EXP
	MOV   (UINT),0
	MOV.D	A7,A1
	POP	A1
	MOV.D	A4,FNAME2
	JMP	SD6
SD4:	MOV.D	A4,FNAME
	MOV.D	A1,TXTBGN
	MOV.D	A7,(TXTUNF)
	SUB.D	A7,TXTBGN
	;INC	A7
SD6:	PUSH	A3
	PUSH	A5
	MOV.D	A6,A1          ; save address
	MOVI	A0,5
	INT	5              ; save FILE
	POP	A5
	POP	A3
	CMPI	A0,0
	JZ	QHOW
SD3:	POP	A7
	POP	A6
	POP	A1
	POPX
	POP	A4
	POP	A5
	JMP	FINISH


;-----------------------------

DELNAME    TEXT  "            "

DELETE:
	CMP	(SDFLAG),256
	JNZ	QHOW
	MOVHL	A0,34
	JSR	IGNBLNK
	JNZ	QWHAT
	MOV.D	A4,DELNAME
	SETX	5
	NTOM  A4,$2020
	MOV.D	A4,DELNAME
	SETX	10
DEL1: CMP.B	(A3),34  ; '"'
	JZ	DEL2
	CMP.B	(A3),13
	JZ	DEL2
	CMP.B	(A3),46  ; '.'
	JNZ	DELN
	SETX	3
	MOV.D	A4,=(DELNAME+8)
	JMP	DSKP
DELN:	MOV.B	(A4),(A3)
	ADDI	A4,1
DSKP:	JXAB	A3,DEL1
	ADDI	A3,1
DEL2:	MOVHL	A0,34
	JSR	IGNBLNK
	JNZ	QWHAT
	MOV.D	A4,DELNAME
	MOVI	A0,4
	INT	5
	MOV	A4,A3
	JMP	FINISH

;-----------------------

CD: 	CMP	(SDFLAG),256
	JNZ	QHOW
	MOV.D	A4,DELNAME
	SETX	5
	NTOM  A4,$2020
	MOVHL	A0,46
	JSR	IGNBLNK
	JNZ	CD3
	MOV.B	(DELNAME),$2E  ; 46 '.'
	CMP.B (A3),46
	JNZ	CD4
	MOV	(DELNAME),$2E2E
	ADDI	A3,1
	JMP	CD4
CD3:	MOVHL	A0,34
	JSR	IGNBLNK
	JNZ	QWHAT
	MOV.D	A4,DELNAME
	SETX	10
CD1: CMP.B	(A3),34  ; '"'
	JZ	CD2
	CMP.B	(A3),13
	JZ	CD2
	CMP.B	(A3),46  ; '.'
	JNZ	CDN
	SETX	3
	MOV	A4,=(DELNAME+8)
	JMP	CSKP
CDN:	MOV.B	(A4),(A3)
	ADDI	A4,1
CSKP:	JXAB	A3,CD1
	ADDI	A3,1
CD2:	MOVHL	A0,34
	JSR	IGNBLNK
	JNZ	QWHAT
CD4:	MOV.D	A4,DELNAME
	MOV	A0,16
	INT	5
	MOV	A5,$2E2E
	CMP   (DELNAME),A5
	JZ	CD5
	CMPI	A0,0
	JZ	QHOW
CD6:	ADD   A0,(FSTCLST)
	SUB	A0,2
	MOV	(CURDIR),A0
CDTL:	MOV.D	A5,THISDIR
	MOV.D A4,DELNAME
      MOV.D (A5),(A4)
	ADDI	A5,4
	ADDI	A4,4
	MOV.D (A5),(A4)
	JMP	FINISH
CD5:  CMPI	A0,0
	JNZ	CD6
	MOV	A0,(FSTCLST)
	SUB	A0,32
	MOV	(CURDIR),A0
	JMP	CDTL

;-------------------------------
RCODE:
	MOV   (UINT),1
	JSR	EXP
	MOV   (UINT),0
	JSR	A1
	JMP	FINISH
;---------------------------

GCODE:
	MOV   (UINT),1
	JSR	EXP
	;MOVI	A5,0
	MOV.D	A5,A1
	MOVHL	A0,44
	JSR	IGNBLNK
	JNZ	QWHAT
	JSR	EXP
	MOV   (UINT),0
	SUBI	A1,1
	SETX  A1
GCWAIT:
	MOVI	A0,0
	INT	4           ; Get byte
	BTST	A0,1        ; if availiable
	JNZ	GC1
	MOVI	A0,7
	INT	4
	BTST	A0,2
	JZ	GCWAIT
	CMP	A1,$76   ; ESC
	JZ    QWHAT
	JMP   GCWAIT
GC1:  
	MOV.B (A5),A1
	JXAB  A5,GCWAIT
	JMP	FINISH

;------------------------------
CLS:	
	MOVI	A0,3
	INT	4
	JMP	FINISH


CLSSP:	SETX	15   ; disable sprites
		MOV	A0,16391
		MOV	A5,16391+256
SPRLP:	OUT.B A0,0
		OUT.B	A5,0
		ADD	A0,4096
		ADD	A5,4096
		OUT.B A0,0
		OUT.B	A5,0
		ADD	A0,4096
		ADD	A5,4096
		OUT.B A0,0
		OUT.B	A5,0
		SUB	A0,8184
		SUB   A5,8184
		JMPX	SPRLP
		JMP	FINISH

ATCMD:           ; POS
	PUSH 	A2
	JSR	EXP
	CMP	A1,24
	JA	ATX
	MOVHL	A0,44
	JSR	IGNBLNK
	JNZ	QWHAT
	MOV.B	(YY),A1
	JSR	EXP
	CMP	A1,79
	JA	ATX
	MOV.B	A2,A1
	MOV.B	(XX),A1
ATX:	JSR	IGNTOCR
	POP	A2
	JMP 	FINISH

COLOR:
	JSR	EXP
	CMP	A1,(DEFY)
	JA	QWHAT
	MOV	A5,A1
	MOVHL	A0,44
	JSR	IGNBLNK
	JNZ	QWHAT
	JSR	EXP
	CMP	A1,(DEFX)
	JA	QWHAT
	MULU	A5,80
	ADD	A5,A1
	MOVHL	A0,44
	JSR	IGNBLNK
	JNZ	QWHAT
	JSR	EXP
	ADD	A5,61152 
	OUT.B	A5,A1
	JMP 	FINISH

FORE: JSR	EXP
	AND.B	A1,$0F
	MOV.B	A5,(SCOL)
	AND.B	A5,$F0
	OR.B	A5,A1
	MOV.B	(SCOL),A5
	JMP 	FINISH

BACK: JSR	EXP
	AND.B	A1,$0F
	SLL	A1,4
	MOV.B	A5,(SCOL)
	AND.B	A5,$0F
	OR.B	A5,A1
	MOV.B	(SCOL),A5
	JMP 	FINISH

SCREEN:
	JSR	EXP
	SETX	1199
	MOVHL	A1,A1
	MOV	A5,61152 		
	NTOI	A5,A1
	JMP 	FINISH

PLOTMD:
	JSR	EXP
	MOV.B	(PLOTM),A1
	JMP 	FINISH

MODE:
	JSR	EXP
	CMP   A1,1
	JNZ	MOD0
	MOV	A0,24
	MOV.B (SCOL),$1F
	JMP   MODX
MOD0:	MOV	A0,29
	MOV   (DEFX),105
	SETX  1589     ; set colors 
	MOV	A5,61152
	NTOI  A5,$F1F1 
	JR	8
MODX:	MOV   (DEFX),52
	MOV	(DEFY),A0
	OUT	24,A1
	MOV.B (VMODE),A1		
	MOVI	A0,3
	INT	4
	JMP 	FINISH

TPLOT:
	PUSH 	A2
	JSR	EXP
	CMP	A1,639
	JA	PLTX
	MOVHL	A0,44
	JSR	IGNBLNK
	JNZ	QWHAT
	MOV	A5,A1
	JSR	EXP
	CMP	A1,239
	JA	PLTX
	MOV	A2,A1
	MOV	A1,A5
	MOVI	A0,2
	INT	4
PLTX:	JSR	IGNTOCR
	POP	A2
	JMP 	FINISH

LINE: PUSH 	A2
	PUSH	A4
	JSR	EXP
	PUSH	A1
	MOVHL	A0,44
	JSR	IGNBLNK
	JNZ	QWHAT
	JSR	EXP
	PUSH	A1
	MOVHL	A0,44
	JSR	IGNBLNK
	JNZ	QWHAT
	JSR	EXP
	PUSH	A1
	MOVHL	A0,44
	JSR	IGNBLNK
	JNZ	QWHAT
	JSR	EXP
	MOV.D	A5,A3
	MOV.D	A4,A1
	POP	A3
	POP	A2
	POP	A1
	MOVI	A0,14
	INT	5
	MOV.D	A3,A5
	POP	A4
	POP	A2
	JMP   FINISH

CIRCLE: 
	PUSH 	A2
	JSR	EXP
	PUSH	A1
	MOVHL	A0,44
	JSR	IGNBLNK
	JNZ	QWHAT
	JSR	EXP
	PUSH	A1
	MOVHL	A0,44
	JSR	IGNBLNK
	JNZ	QWHAT
	JSR	EXP
	MOV.D	A5,A3
	MOV.D	A3,A1
	POP	A2
	POP	A1
	MOV.D	A0,17
	INT	5
	MOV.D	A3,A5
	POP	A2
	JMP   FINISH



BEEP:
	PUSH	A6
	PUSH	A2
	JSR	EXP
	MOV.D	A5,A1
	MOVI	A1,0
	MOV.D	A6,$00008000
	MOVHL	A0,44
	JSR	IGNBLNK
	JNZ	BEE1
	JSR	EXP
	MOV.D	A6,A1
	SLL   A6,13
	MOVHL	A0,44
	JSR	IGNBLNK
	MOVI	A1,0
	JNZ	BEE1
	PUSH	A6
	JSR	EXP
	POP	A6
BEE1:	XCHG  A1,A5
	MOV.D	A2,200000
	MOVI	A0,6
	INT	5
	AND.D A1,$00001FFF
	ADD.D	A1,A6
	SLL	A5,1
	ADDI	A5,8
	OUT	A5,A1
	POP	A2
	POP	A6
	JMP 	FINISH

POKE:
	MOV   (UINT),1
	JSR	EXP
	MOV   (UINT),0
	MOVHL	A0,44
	JSR	IGNBLNK
	JZ	POK2
	JMP	QWHAT
POK2:	SUBI	A1,1
POK1: ADDI	A1,1
	PUSH	A1
	MOV	(UINT),1
	JSR	EXP
	MOV	(UINT),0
	MOV.B	A0,A1
	POP	A1
	MOV.B	(A1),A0
	MOVHL	A0,44
	JSR	IGNBLNK
	JNZ	FINISH
	JMP	POK1

OUTBCMD:
	MOV   (UINT),1
	JSR	EXP
	MOV   (UINT),0
	MOVHL	A0,44
	JSR	IGNBLNK
	JZ	OUTB2
	JMP	QWHAT
OUTB2: SUBI	A1,1
OUTB1: ADDI	A1,1
	PUSH	A1
	MOV	(UINT),1
	JSR	EXP
	MOV	(UINT),0
	MOV.B	A0,A1
	POP	A1
	OUT.B	A1,A0
	MOVHL	A0,44
	JSR	IGNBLNK
	JNZ	FINISH
	JMP	OUTB1

PEEK:
	MOV   (UINT),1
	JSR	EXP
	MOV   (UINT),0
	MOV.B	A1,(A1)
	MOVHL	A1,0
	RET

JOYST1:
	IN	A1,22
	NOT	A1
	AND	A1,31
	RET

JOYST2:
	IN	A1,22
	SWAP	A1
	NOT	A1
	AND	A1,31
	RET

TIMER:
	IN	A1,21
	BCLR	A1,15
	SWAP.D A1
	IN	A1,20
	RET

TOINT:
	JSR	PARN
	;CMP	A1,0
	BTST	A1,31
	JZ	TOI1
	INC	A1
TOI1:	MOVI	A7,0
	RET

ROUND:
	JSR	PARN
	ADD.D	A7,$80000000
	ADC.D	A1,0
	MOVI	A7,0
	RET

RND:	JSR	PARN
	OR	A1,A1
	JN	QHOW
	JNZ	RND1
	MOVI	A1,0
	RET
RND1:	
	MOV	A0,(RAND)
	PUSH  A2
	MOV 	A2,997
	MULU	A2,A0
      IN    A0,20
      ADD   A2,A0
      MOV   (RAND),A2
	MOVI	A0,6
	INT	5     ; DIV by A1
	MOVI  A1,0
	MOV	A1,A0
	INC	A1
      POP   A2
	RET

PI:	MOVI	A1,3
	MOV.D	A7,$243F6A88
	RET

BTOP:	MOV.D	A1,(TXTUNF)
      BTST  A1,0
	JRZ   2
	ADDI  A1,1
	MOVI	A7,0
	RET

SQRT: PUSH	A2
	PUSH	A4
	PUSH	A0
	JSR	PARN
	SRL.D	A7,1
	SRL.D	A1,1
	JNC	SQ1
	OR.D	A7,$80000000  ; Set Xo = A/2
SQ1:	MOV.D	A5,A1
	MOV.D	A6,A7  ; copy A/2 to A5A6
	SETX	5       ; 6 interations
SQ2:	MOV.D	A2,A5
	MOV.D	(FRAC2),A6
	MOV.D	(FRAC1),A7
	PUSH	A1
	PUSH	A7
	;MOVI	A0,1
	;INT	5
	JSR	FDIV
	MOV.D	A7,(FRAC1)
	POP	A4
	POP	A2
	SRL.D	A4,1
	SRL.D	A2,1
	JNC	SQ3
	OR.D	A7,$80000000
SQ3: 	ADD.D	A7,A4
	ADC.D	A1,A2
	JMPX	SQ2
	POP	A0
	POP	A4
	POP	A2
	RET

;EXPO:	RET
;LN:	RET

SINP11	EQU	$0001
SINP12	EQU	$45F306C8
SINP21	EQU	$0000
SINP22	EQU	$67C0BD8A


COS:	PUSH	A2
	PUSH	A4
	PUSH	A0
	JSR	PARN
	MOV.D	A0,A7
	ADD.D	A0,$921FB544	
	ADC.D	A1,1
	CMPI	A1,3
	JZ	COS2
	JL	CSSK
COS2:	SUBI	A1,6
	SUB.D	A0,$487ED4F2 ;2*pi 243F6A88
	JNC	CSSK 
	;ADDI	A1,1 
	SUBI	A1,1 
CSSK:	MOV.D	A7,A0
	JMP	COSI


SIN:  PUSH	A2
	PUSH	A4
	PUSH	A0
	JSR	PARN

COSI:	PUSH	A3
	MOV.D	(FRAC2),SINP12 ;A2
	MOV.D	(FRAC1),A7
	MOVI	A2,1
	PUSH	A1                 ; save parameter
	JSR	FMULT
	POP	A0	;get param
	PUSH	A1    ; save res
	MOV.D	A1,(FRAC1)
	PUSH	A1
	MOV.D	A1,A0 	; get param again
	PUSH	A1    	; save again
	MOV.D	(FRAC2),SINP22 ;A2
	MOV.D	(FRAC1),A7
	MOVI	A2,0       ;(SINP21)
	;MOVI	A0,0
	;INT	5          ; X*0.405284735
	JSR	FMULT
	POP	A2
	PUSH	A2           ;  again save 
	MOV.D	A0,A7
	MOV.D	(FRAC2),A0
	;MOVI	A0,0        ; X*X*0.405284735
	;INT   5
	JSR	FMULT       
	MOV.D	A2,(FRAC1)  ; result in A1A2
	POP	A0 ; get param
	POP	A4 ; first result
	POP	A3
	BTST	A0,31
	;CMPI	A0,0
	JZ   SIN1
	ADD.D	A2,A4 
	ADC.D	A1,A3
	JMP	SIN2
SIN1:
	NOT.D	A1
	NEG.D	A2
	ADC.D	A1,0
	ADD.D	A2,A4
	ADC.D	A1,A3
SIN2: MOV.D	A7,A2
	POP	A3
	POP	A0
	POP	A4
	POP	A2
	RET


WAITK:
	MOVI	A0,0
	INT	4           ; Get keyboard code
	BTST	A0,1        ; if availiable
	JNZ	WK1
	MOVI	A0,7
	INT	4
	BTST	A0,2
	JZ	WAITK
	MOVI	A0,10
	INT	4
WK1:
	RET	

KEY:  MOVI  A1,0
	MOVI	A0,0
	INT	4           ; Get keyboard code
	BTST	A0,1        ; if availiable
	JNZ	WK2
	MOVI	A0,7
	INT	4
	BTST	A0,2
	JZ	WK2
	MOVI	A0,10
	INT	4
WK2:
	RET	


SDINIT:
	MOVI	A0,11
	INT	4
	MOV	A1,A0
	MOVI	A0,3
	INT	5
	MOV	A0,(SDFLAG)
	RET


CLRMEM:	PUSH	A1
		PUSH	A0
		PUSHX
		MOV.D	A1,TXTBGN
		MOV.D	A0,TXTEND
		SUB.D	A0,A1
		SRL.D	A0,2
		SUBI	A0,1
		SETX	A0	
		NTOM	A1,0
		ADD.D	A1,A0
		SETX	A0
		NTOM	A1,0
		MOV.D	A1,VARBGN
		MOV.D	A0,VAREND
		SUB.D	A0,A1
		SRL.D	A0,1
		SUBI	A0,1
		SETX	A0	
		NTOM  A1,0
		POPX
		POP	A0
		POP	A1
		RET

;----- GETLN

;NOTCOL:
;	PUSH	A2
;	PUSH	A5
;	MOVI	A5,0
;	MOV	A2,(XX)
;	MOV.B	A5,A2
;	MULU	A5,80
;	SRL	A2,8
;	ADD	A5,A2
;	ADD	A5,61152
;	IN.B	A2,A5
;	NOT	A2
;	OUT.B	A5,A2
;	POP	A5
;	POP	A2
;	RET


GETLN:
		jsr	chrout
		push	A1
		mov.D	A4,BUFFER   ; a4<->di
GL1:		
		MOVI	A0,0
		INT	4           ; Get keyboard code for serial port
		BTST  A0,1
		JNZ   KEYIN
		BTST	A0,2        ; if availiable
		JZ	GL1
GL6:		MOVI	A0,7
		INT	4
		BTST	A0,2
		JZ	GL1
		MOVI	A0,10
		INT	4
KEYIN:
		MOV	A0,A1      ; CHAR IN A0
	      CMPI.B A0,8       ; BS
		JNZ   GL2
		CMP.D	A4,BUFFER
		JBE	GL1
		SUB.B	(XX),1
		JP	GL4
		MOV.B	(XX),0
		JMP	GL1
GL4:		SUBI	A4,1
		PUSH	A2
		MOV	A2,(XX)
		MOVI	A0,4
		MOV	A1,32
		INT	4
		POP	A2
		JMP	GL1
GL2:		MOV.B	(A4),A0
		ADDI	A4,1
		CMPI.B A0,13
		JZ    GL1E
		CMP.D	A4,BUFEND
		JZ	gl3
		JSR	CHROUT
		JMP	GL1
GL3:		
		SUBI	A4,1
		JMP	GL1
GL1E:		
		JSR	CHROUT
		MOV.B	(A4),13
		POP	A1
		MOV.D	A3,A4
		RET
		
FNDLN:	
		OR	A1,A1
		JN	QHOW
		MOV.D	A3,TXTBGN
FNDLNP:
FL1:		
		MOV.D	A0,(TXTUNF)
		SUBI	A0,1
		CMP.D	A0,A3
		JC	RET13
		MOV.D	A4,A3
		MOVI	A0,0
		mov.b	a0,(a4)
		swap	a0
		ADDI	a4,1
		mov.b	a0,(a4)
		CMP	A0,A1
		JC	FNDNXT
RET13:	RET

FNDNXT:	ADDI	A3,1
FL2:		ADDI	A3,1
FNDSKP:	MOV.B	A0,(A3)
		CMPI.B  A0,13
		JNZ	FL2
		ADDI	A3,1
		JMP	FL1

; ----  CHROUT
CRLF:		MOVI	A0,$0D
CHROUT:	OR.B	A0,A0
		JZ	RET9
		PUSH	A0
		CMPI.B A0,$0D
		JZ	CR_SCRL
		PUSH	A1
		PUSH 	A2
		MOV	A1,A0
		MOV	A2,(XX)
		MOV	A0,4
		CMP.B	(SER),1   ; REDIRECT TO SERIAL ?
		JNZ	NRMI
		MOVI	A0,1
NRMI:		INT	4
		SWAP	A2
		MOV	A0,(DEFX)
		SUBI	A0,1
		CMP.B	A2,A0
		JBE	SKP4
		JSR 	CRLF
		MOV	A2,-1	
SKP4:		INC.B	A2
		MOV.B	(XX),A2
		POP	A2
		POP	A1
		POP	A0
		RET

CR_SCRL:	PUSH	A1
		MOVI	a0,6
		CMP.B	(SER),1
		JNZ	NRMI2
		MOVI	A1,13
		MOVI	A0,1
NRMI2:
		INT	4
		CMP.B	(SER),1
		JNZ	SKP3
		MOVI	A0,1
		MOVI	A1,10
		INT	4
SKP3:		MOV.B	(XX),0
		POP	A1
		POP	A0
		RET

CHKIO:
	IN	A0,6
	AND   A0,6
	JNZ	CI0
	RET
CI0:	PUSH	A1
	MOVI	A0,0
	INT	4           ; Get keyboard code
	BTST	A0,1        ; if availiable
	JNZ	CI1
	MOVI	A0,7
	INT	4
	BTST	A0,2
	JZ	IDONE
	MOVI	A0,10
	INT	4
CI1:	
	CMP.B	A1,27
	JNZ	IDONE
	JMP	RSTART
IDONE:
	POP	A1
	RET

PRTSTG:     
	MOVHL	A2,A0
PS1:
	MOV.B A0,(A3)
	ADDI	A3,1
	SWAP	A2
	CMP.B	A2,A0
	SWAP	A2
	JNZ	PS2
	RET
PS2:
	JSR	CHROUT
	CMPI.B A0,13
	JNZ	PS1
	RET	

QTSTG:
	MOVHL	A0,34
	JSR	IGNBLNK
	JNZ	QT3
	MOV.B	A0,34
QT1:
	JSR	PRTSTG
	CMPI.B A0,13
	POP	A1
	JNZ	QT2
	JMP	RUNNXL
QT2:
	ADDI	A1,6
	JMP	A1
QT3:
	MOVHL	A0,39
	JSR	IGNBLNK
	JNZ	QT4
	MOV.B	A0,39
	JMP	QT1
QT4:
	MOVHL	A0,92
	JSR	IGNBLNK
	JNZ	QT5
	POP	A1
	JMP	QT2
QT5:
	RET

	;---------  DISPLAY NUMBER -----

PRTUNUM:  ; UNSIGNED 
	PUSH	A3
	MOVI	A3,10	
	PUSH	A3
	MOVHH	A2,A3
	MOV.D	A4,A2
PUN2:
	JSR	UDIVIDE ; unsigned div A1 by A3 res in A2,A1
	CMPI	A2,0
	JZ	PUN3
	PUSH	A1
	DEC.B	A4
	MOV.D	A1,A2
	JMP	PUN2
PUN3:
	MOV.D	A2,A4
PUN4:
	DEC.B	A2
	OR.B	A2,A2 
	JN	PUN5
	MOV.B	A0,'0'
	CMP	(LZERO),1
	JRZ	4
	MOV.B	A0,32
	JSR	CHROUT
	JMP	PUN4
PUN5:
	MOVLH	A0,A2
	JSR	CHROUT
	MOV.B	A3,A1
PUN6:
	MOV.B	A0,A3
	CMPI.B A0,10
	POP	A3
	JZ	RET14
	ADD.B	A0,48
	JSR	CHROUT
	JMP	PUN6
;----------------------------------

PRTNUM:	            ;signed
	PUSH	A3
	MOVI	A3,10	
	PUSH	A3
	AND.D	A2,$000000FF
	DEC.B	A2
	JSR	CHKSGN 
	JP	PN1
	MOVHL	A2,'-'
	DEC.B	A2
PN1:
	MOV	A4,A2
PN2:
	JSR	DIVIDE     ; integer div A1 by A3 res in A2,A1
	CMPI	A2,0
	JZ	PN3
	PUSH	A1
	DEC.B	A4
	MOV.D	A1,A2
	JMP	PN2
PN3:
	MOV	A2,A4
PN4:
	DEC.B	A2
	OR.B	A2,A2 
	JN	PN5
	MOV.B	A0,32
	JSR	CHROUT
	JMP	PN4
PN5:
	MOVLH	A0,A2
	JSR	CHROUT
	MOV.B	A3,A1
PN6:
	MOV.B	A0,A3
	CMPI.B A0,10
	POP	A3
	JZ	RET14
	ADD.B	A0,48
	JSR	CHROUT
	JMP	PN6

PRTLN:
	MOV.D	A4,A3
	JSR	LODSW
	MOV	A1,A0
	ADDI	A3,2
PRTLN1:
	MOV.B	A2,4
	JSR	PRTNUM
	MOV.B	A0,32
	JSR	CHROUT
	SUB.B	A0,A0
	JSR	PRTSTG
RET14:
	RET

;---------- MVUP MVDOWN

MVUP:
	CMP.D	A3,A1
	JZ	RET15
	MOV.B	(A2),(A3)  ; replace 4 lines
	ADDI	A3,1
	ADDI	A2,1
	JMP	MVUP

MVDOWN:
	CMP.D	A3,A2
	JZ	RET15
	SUBI	A3,1
	SUBI	A1,1
	MOV.B (A1),(A3)
	JMP	MVDOWN

POPA:
	POP	A2
	POP	A1
	MOV.D	(LOPVAR),A1
	CMPI	A1,0
	JZ	PP1
	POP	A1
	MOV.D	(LOPINC),A1
	POP	A1
	MOV.D	(LOPLMT),A1
	POP	A1
	MOV.D	(LOPLN),A1
	POP	A1
	MOV.D	(LOPPT),A1
PP1:	PUSH	A2   ; return address
RET15:
	RET

PUSHA:
	MOV.D	A5,STKLMT
	POP	A2
	GETSP	A0
	SUB.D	A0,A5
	JC	QSORRY

	MOV.D	A1,(LOPVAR)
	CMPI	A1,0
	JZ	PU1
	MOV.D	A1,(LOPPT)
	PUSH	A1
	MOV.D	A1,(LOPLN)
	PUSH	A1
	MOV.D	A1,(LOPLMT)
	PUSH	A1
	MOV.D	A1,(LOPINC)
	PUSH	A1
	MOV.D	A1,(LOPVAR)
PU1:
	PUSH	A1
	PUSH	A2
	RET

;----------- ignblnk ---------

IGNBLNK:   ; eat whitespace including a0 high

ign1:
	mov.b	a0,(a3)
	cmp.b	a0,32
	jnz	ign2
	ADDI	a3,1
	jmp	ign1
ign2:
	swap	a0
	cmp.b	(a3),a0
	swap  a0

	jnz	_ret
	ADDI	a3,1
	srset	2  ; zero
_ret:	ret

IGNTOCR:  ; ignore chars till next statement
	MOV.B	A0,(A3)
	CMPI.B A0,13
	JZ	IGNCRE
	CMP.B	A0,59
	JZ	IGNCRE		
	ADDI	A3,1
	JMP	IGNTOCR
IGNCRE:
	RET
	
;--------------------------------

STOSW: 
	swap	a0
	mov.b	(a4),a0
	ADDI	a4,1
	swap	a0
	mov.b	(a4),a0
	ADDI	a4,1
	RET
LODSW:
	mov.b	a0,(a4)
	swap	a0
	ADDI	a4,1
	mov.b	a0,(a4)
	ADDI	a4,1
	RET
;----------ADDED

OUTCMD:
	MOV   (UINT),1
	JSR	EXP
	MOV   (UINT),0
	MOVHL	A0,44
	JSR	IGNBLNK
	JZ	OUT2
	JMP	QWHAT
OUT2: ADDI	A1,2
OUT1: SUBI	A1,2
	PUSH	A1
	MOV	(UINT),1
	JSR	EXP
	MOV	(UINT),0
	MOV	A0,A1
	POP	A1
	OUT	A1,A0
	MOVHL	A0,44
	JSR	IGNBLNK
	JNZ	FINISH
	JMP	OUT1

INP:	MOV	(UINT),1
	JSR	PARN
	MOV	(UINT),0
	IN	A1,A1
	RET

; 'usr(i(,j))'
;
; usr call a machine language subroutine at location 'i'  if
; the optional parameter 'j' is used its value is passed  in
; hl. the value of the function should be returned in hl.

USR:
	PUSH	A2
	MOVHL	A0,'('
	JSR	IGNBLNK
	JNZ	QWHAT
	JSR	EXP
	MOVHL	A0,')'
	JSR	IGNBLNK
	JNZ	PASPRM
	PUSH	A3
	MOV.D	A3,USRET
	PUSH	A3
	PUSH	A1
	RET
PASPRM:
	MOVHL	A0,44
	JSR	IGNBLNK
	JNZ	USRET1
	PUSH	A1
	JSR	EXP
	MOVHL	A0,')'
	JSR	IGNBLNK
	JNZ	USRET1
	POP	A2
	PUSH	A3
	MOV.D	A3,USRET
	PUSH	A3
	PUSH	A2
	RET
USRET:
	POP	A3
USRET1:
	POP	A2
	RET

;outio:
; 	out $FFFF,A1
; 	ret

;INPIO:
;	IN	A1,$FFFF
;	RET

; Div A2.(FRAC2)/A1.(FRAC1) res in A1.(FRAC1), restoring division 9/5/2017
FDIV:		
		PUSH		A3
		PUSH		A4
		PUSH		A7
		PUSHX
		MOV.D		A0,A2
		XOR.D		A0,A1
		PUSH		A0
		CMPI		A1,0          ; check if neg and convert
		JP		FDIV2
		NOT.D		A1
		MOV.D		A4,(FRAC1)
		NEG.D		A4
		ADC.D		A1,0
		MOV.D		(FRAC1),A4
FDIV2:	MOV.D		A4,(FRAC2)
		CMPI		A2,0          ; check if neg and convert 
		JP		FDIV3
		NOT.D		A2
		NEG.D		A4
		ADC.D		A2,0          ; A2A4 = Q Divident
FDIV3:	MOV.D		A3,(FRAC1)

		SETX		31            ; shift dividend as left as possible
FDC1:		BTST		A2,31
		JNZ		FDC2
		SLLL.D	A2,A4
		JMPX		FDC1
FDC2:		MOVX		A0
		CMPI		A0,6
		JBE		FDC3
		SETX		9
		BTST		A3,0
		JNZ		FDC9
FDC5:		SRLL.D	A1,A3
		SUBI		A0,1
		JMPX		FDC5		
FDC9:		SETX		A0
FDC3:		PUSHX		

		NOT.D		A1
		NEG.D		A3
		ADC.D		A1,0
		MOV.D		A7,A1    ; store -M
		MOV.D		(FRAC2),A3
		MOVI		A1,0
		MOVI		A3,0	   	; A1A3 = A
		SETX		62
FD_INTER:
		SLLL.D	A1,A3           ; shift AQ left
		SLLL.D	A2,A4
		ADC.D		A3,0
		PUSH		A1
		PUSH		A3
		ADD.D		A3,(FRAC2)   	;A=A-M
 		ADC.D		A1,A7
		JP		FD_COND1   
		POP		A3
		POP		A1
		BCLR		A4,0
		JMP		FD_COND2
FD_COND1:	POP		A0
		POP		A0	
		BSET		A4,0       
FD_COND2:	JMPX		FD_INTER
		
		POP		A0          ; shift left as needed
		ADDI		A0,1
		;SUBI		A0,1
		JN		FDC6
		SETX		A0
FDLP:		SLLL.D	A2,A4
		JMPX		FDLP
		JMP		FDC7

FDC6:		INC		A0
		JZ		FDC7
		SRLL.D	A2,A4        ; or shift right as needed
FDC8:		JMP		FDC6

FDC7:		MOV.D		A1,A2	     ; integer result in A1
		POP		A0
		CMPI        A0,0
		JP		FDIVEND     ; correct sign
		NOT.D		A1
		NEG.D		A4
		ADC.D		A1,0
FDIVEND:	MOV.D		(FRAC1),A4  ; store fraction result 
		POPX
		POP		A7
		POP		A4
		POP		A3
		RET

;-------------------------------------
;  		INT 5 A0=0
; fixed point multiply  A1*A2
FMULT:	
		PUSH		A3
		PUSH		A4
		PUSH		A5
		PUSH		A6
		MOV.D		A0,A2
		XOR.D		A0,A1
		PUSH		A0
		;MOV		A0,31
		BTST		A1,31    ; check if neg and convert 
		JZ		FMUL2
		NOT.D		A1
		MOV.D		A4,(FRAC1)
		NEG.D		A4
		ADC.D		A1,0
		MOV.D		(FRAC1),A4
FMUL2:	BTST		A2,31   ; check if neg and convert 
		JZ		FMUL3
		NOT.D		A2
		MOV.D		A4,(FRAC2)
		NEG.D		A4
		ADC.D		A2,0
		MOV.D		(FRAC2),A4
FMUL3:	MOV.D		A5,A1
		MOV.D		A6,A2
		MULU.D	A1,A2
		MOV.D		A0,A2
		MOV.D		A3,A1
		MOV.D		A1,(FRAC1)
		MOV.D		A2,(FRAC2)
		MOV.D		A4,A1
		OR.D		A4,A2
		JZ		FMULZ ; skip more mults if fractions = zero
		MULU.D	A1,A2
		MOV.D		A4,A2 ; store result fraction
		MOV.D		A1,(FRAC1)
		MOV.D		A2,A6
		MULU.D	A1,A2
		ADD.D		A4,A1
		ADC.D		A3,A2
		ADC.D		A0,0
		MOV.D		A1,(FRAC2)
		MOV.D		A2,A5
		MULU.D	A1,A2
		ADD.D		A4,A1
		ADC.D		A3,A2
		ADC.D		A0,0	
FMULZ:	MOV.D		A1,A3
		POP		A2
		;MOV.D		A3,31
		BTST		A2,31
		MOV.D		A2,A0
		JZ		FMULEND     ; Check result sign
		NOT.D		A1
		NOT.D		A2
		NEG.D		A4
		ADC.D		A1,0
		ADC.D		A2,0
FMULEND:	MOV.D		(FRAC1),A4
		POP		A6
		POP		A5
		POP		A4
		POP		A3
		RET



;-----------------------------------------------------
; DATA
FRAC1		DD	0   ; for fixed point multiplication-division
FRAC2		DD	0    
UINT		DW	0
LZERO		DW	1

DUMMY		DW	0
XX		DB	0
YY		DB	0
DEFY		DW	29
DEFX		DW	79

FNAME       TEXT	"        BAS"
		DB	13
FNAME2      TEXT	"        BIN"
		DB	13
FNAME3      TEXT	"        SCR"
		DB	13
THISDIR     TEXT  "ROOT     "
		DB	13
TITLE		TEXT	"TINY BASIC for LION SYSTEM 2016"
		DB	13
how		TEXT  "How?"
		DB	$0d
OK		TEXT	"OK"
		DB	13
what		TEXT    "What?"
		DB	$0d
sorry		TEXT    "Sorry"
		DB    $0d
NFND		TEXT    "Not found"
		DB    $0d

SER		DB	0,0
RAND		DW	983
CURRNT	DD	0
STKGOS	DD	0
VARNXT	DD	0
STKINP	DD	0
LOPVAR	DD	0
LOPINC	DD	0
LOPLMT	DD	0
LOPLN		DD	0
LOPPT		DD	0
		DB	80
		DB	0
TXTUNF	DA    TXTBGN
		DS	4
TXTBGN	DS	80000   ; program space
TXTEND	DS	4
VARBGN	DS	1024
VAREND	DS	4
BUFFER	DS	79
BUFEND	DS	5
STKLMT	DS	4096
STACK		DS	4



